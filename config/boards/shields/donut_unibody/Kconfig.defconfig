## config/boards/shields/donut_unibody/Kconfig.defconfig
```kconfig
if SHIELD_DONUT_UNIBODY
            
config ZMK_KEYBOARD_NAME
    default "donut_unibody"

endif
```

## config/boards/shields/donut_unibody/Kconfig.shield
```kconfig
config SHIELD_DONUT_UNIBODY
    def_bool $(shields_list_contains, donut_unibody)
```
